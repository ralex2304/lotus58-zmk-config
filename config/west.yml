## config/west.yml
```yaml
manifest:
  remotes:
    - name: zmkfirmware
      url-base: https://github.com/ralex2304
    - name: ralex2304
      url-base: https://github.com/ralex2304
  projects:
    - name: zmk
      remote: zmkfirmware
      revision: lotus58_studio
      import: app/west.yml
    - name: nice-view-elemental-cat
      remote: ralex2304
      revision: main
  self:
    path: config
```
